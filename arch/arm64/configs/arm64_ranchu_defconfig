## drivers/staging/goldfish/Kconfig
```kconfig
config GOLDFISH_AUDIO
	tristate "Goldfish AVD Audio Device"
	depends on GOLDFISH && HAS_IOMEM
	---help---
	  Emulated audio channel for the Goldfish Android Virtual Device

config GOLDFISH_SYNC
    tristate "Goldfish AVD Sync Driver"
    depends on GOLDFISH
    depends on HAS_IOMEM
    depends on SW_SYNC
    depends on SYNC_FILE
	---help---
	  Emulated sync fences for the Goldfish Android Virtual Device
```
